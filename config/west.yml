## config/west.yml
```yaml
manifest:
  remotes:
    - name: zmkfirmware
      url-base: https://github.com/zmkfirmware
  projects:
    - name: zmk
      remote: zmkfirmware
      revision: 7bd74a6b0fcd9891dec1c6960bf49a0bf73a010e
      import: app/west.yml
  self:
    path: config
```
